## west.yml
```yaml
manifest:
  # version: <west_version>

  defaults:
    remote: upstream

  remotes:
    - name: upstream
      url-base: https://github.com/noobwang233/  # my test zephyr source code

  projects:
    - name: zephyr          # project name, project name + remote is the repo of this project
      description: zephyr rtos source code
      revision: master      # label or commit id of project
      clone-depth: 1        # only clone the last commit
      import:               # import from west.yml of zephyr
        path-prefix: external # create external folder of project
        name-allowlist:     # import other modules from west.yml of zephyr
          - cmsis           # required by the ARM port for Cortex-M CMSIS 5.x
          - cmsis_6         # required by the ARM port for Cortex-M CMSIS 6
          - cmsis-dsp
    - name: hal_gigadevice  # required by the gd32e503z_eval board (GD32 based)
      revision: main
      path: external/modules/hal/gigadevice
      groups:
        - hal
  self:
    path: west-manifest
    west-commands: west-commands.yml
```
